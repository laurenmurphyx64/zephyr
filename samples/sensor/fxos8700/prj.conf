## prj.conf
```kconfig
CONFIG_STDOUT_CONSOLE=y
CONFIG_LOG=y
CONFIG_I2C=y
CONFIG_SENSOR=y
CONFIG_FXOS8700=y
CONFIG_SENSOR_LOG_LEVEL_DBG=y
CONFIG_FXOS8700_MODE_HYBRID=y
CONFIG_FXOS8700_TEMP=y
# CONFIG_FXOS8700_TRIGGER_OWN_THREAD=y
CONFIG_FXOS8700_TRIGGER_NONE=y
CONFIG_CBPRINTF_FP_SUPPORT=y
```

## src/main.c
```c
/*
 * Copyright (c) 2016 Freescale Semiconductor, Inc.
 * Copyright (c) 2018 Phytec Messtechnik GmbH
 *
 * SPDX-License-Identifier: Apache-2.0
 */

#include <zephyr.h>
#include <drivers/sensor.h>
#include <stdio.h>

#define MS2_IN_G 9.80665

static inline float out_ev(struct sensor_value *val)
{
	return (((val->val1 + (float)val->val2 / 1000000) / MS2_IN_G) * 1000);
}

K_SEM_DEFINE(sem, 0, 1);	/* starts off "not available" */

#if !defined(CONFIG_FXOS8700_TRIGGER_NONE)
static void trigger_handler(const struct device *dev,
			    struct sensor_trigger *trigger)
{
	ARG_UNUSED(trigger);

	/* Always fetch the sample to clear the data ready interrupt in the
	 * sensor.
	 */
	if (sensor_sample_fetch(dev)) {
		printf("sensor_sample_fetch failed\n");
		return;
	}

	k_sem_give(&sem);
}
#endif /* !CONFIG_FXOS8700_TRIGGER_NONE */

void main(void)
{
	struct sensor_value accel[3];
	const struct device *dev = device_get_binding(DT_LABEL(DT_INST(0, nxp_fxos8700)));

	if (dev == NULL) {
		printf("Could not get fxos8700 device\n");
		return;
	}

	struct sensor_value attr = {
		.val1 = 6,
		.val2 = 250000,
	};

	if (sensor_attr_set(dev, SENSOR_CHAN_ALL,
			    SENSOR_ATTR_SAMPLING_FREQUENCY, &attr)) {
		printk("Could not set sampling frequency\n");
		return;
	}

#ifdef CONFIG_FXOS8700_MOTION
	attr.val1 = 10;
	attr.val2 = 600000;
	if (sensor_attr_set(dev, SENSOR_CHAN_ALL,
			    SENSOR_ATTR_SLOPE_TH, &attr)) {
		printk("Could not set slope threshold\n");
		return;
	}
#endif

#if !defined(CONFIG_FXOS8700_TRIGGER_NONE)
	struct sensor_trigger trig = {
#ifdef CONFIG_FXOS8700_MOTION
		.type = SENSOR_TRIG_DELTA,
#else
		.type = SENSOR_TRIG_DATA_READY,
#endif
		.chan = SENSOR_CHAN_ACCEL_XYZ,
	};

	if (sensor_trigger_set(dev, &trig, trigger_handler)) {
		printf("Could not set trigger\n");
		return;
	}
#endif /* !CONFIG_FXOS8700_TRIGGER_NONE */

	while (1) {
#ifdef CONFIG_FXOS8700_TRIGGER_NONE
		k_sleep(K_MSEC(50));
		sensor_sample_fetch(dev);
#else
		k_sem_take(&sem, K_FOREVER);
#endif
		sensor_channel_get(dev, SENSOR_CHAN_ACCEL_XYZ, accel);
		/* Print accel x,y,z data */
		// printf("AX=%10.6f AY=%10.6f AZ=%10.6f ",
		//        out_ev(&accel[0]),
		//        out_ev(&accel[1]),
		//        out_ev(&accel[2]));

		printk("%10.6f,%10.6f,%10.6f\r\n", out_ev(&accel[0]), out_ev(&accel[1]), out_ev(&accel[2]));

		printk("%04.2f,%04.2f,%04.2f\r\n", 
			(float)convert_ms2_to_mg(&accel_x_out),
			(float)convert_ms2_to_mg(&accel_y_out),
			(float)convert_ms2_to_mg(&accel_z_out));

// #if defined(CONFIG_FXOS8700_MODE_MAGN) || defined(CONFIG_FXOS8700_MODE_HYBRID)
// 		struct sensor_value magn[3];

// 		sensor_channel_get(dev, SENSOR_CHAN_MAGN_XYZ, magn);
// 		/* Print mag x,y,z data */
// 		printf("MX=%10.6f MY=%10.6f MZ=%10.6f ",
// 		       sensor_value_to_double(&magn[0]),
// 		       sensor_value_to_double(&magn[1]),
// 		       sensor_value_to_double(&magn[2]));
// #endif
// #ifdef CONFIG_FXOS8700_TEMP
// 		struct sensor_value temp;

// 		sensor_channel_get(dev, SENSOR_CHAN_DIE_TEMP, &temp);
// 		/* Print accel x,y,z and mag x,y,z data */
// 		printf("T=%10.6f", sensor_value_to_double(&temp));
// #endif
// 		printf("\n");
	}
}
```
