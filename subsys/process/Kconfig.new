## subsys/process/Kconfig.new
```kconfig
# Copyright (c) 2026 The Zephyr Project Contributors
# SPDX-License-Identifier: Apache-2.0

menuconfig PROCESS
	bool "Zephyr Process Model"
	select THREAD_NAME
	help
	  Enable the Zephyr process model subsystem.

	  The process model groups one or more Zephyr threads into a logical
	  "process" with a shared lifecycle.  Processes may optionally:

	    - Load their code from an ELF binary at runtime (LLEXT)
	    - Run in a dedicated memory domain (CONFIG_USERSPACE)
	    - Share stacks and arbitrary partitions between all of their
	      threads
	    - Run their threads in unprivileged mode

if PROCESS

config PROCESS_LLEXT
	bool "Support LLEXT-backed processes"
	depends on LLEXT
	default y if LLEXT
	help
	  When enabled, processes can be loaded from ELF binaries via the
	  LLEXT subsystem using z_process_load() / z_process_spawn().  When
	  disabled, only "native" processes (whose threads run code already
	  linked into the main image) are supported.

config PROCESS_NAME_MAX_LEN
	int "Maximum length of a process name"
	default 15
	range 8 31
	help
	  Maximum number of characters in a process name, not counting the
	  null terminator.  Truncation is silent.

config PROCESS_HEAP_SIZE
	int "Heap (bytes) used for per-thread bookkeeping slots"
	default 1024
	help
	  The process subsystem allocates one z_process_thread slot from a
	  dedicated kernel heap each time z_process_add_thread() is called.
	  Each slot is roughly the size of a struct k_thread plus a
	  k_mem_partition, so a 1024-byte heap typically holds 4-6 threads.

	  Increase this value if your application creates many concurrent
	  process threads and z_process_add_thread() starts returning
	  -ENOMEM.

config PROCESS_STACK_SIZE_DEFAULT
	int "Default process thread stack size (bytes)"
	default 2048
	help
	  Stack size used when z_process_opts.stack_size is 0.

config PROCESS_PRIORITY_DEFAULT
	int "Default process thread scheduling priority"
	default 5
	range -16 14
	help
	  Scheduling priority applied to a new process thread when
	  z_process_opts.priority is not overridden.

config PROCESS_FATAL_HANDLER
	bool "Install a fatal error handler for process threads"
	help
	  When enabled, the process subsystem installs a custom
	  k_sys_fatal_error_handler() that:

	    - If the faulting thread belongs to a process whose
	      opts.halt_on_fault is true, halts the whole system via
	      k_fatal_halt().
	    - Otherwise aborts only the offending thread (the default
	      Zephyr behavior).

	  Do not enable this option if your application already provides its
	  own k_sys_fatal_error_handler().

module = PROCESS
module-str = process
source "subsys/logging/Kconfig.template.log_config"

endif # PROCESS
```

## tests/arch/xtensa/load_store_emulation/testcase.yaml
```yaml
tests:
  arch.xtensa.load_store_emulation:
    arch_allow: xtensa
    tags:
      - kernel
```

## tests/lib/word_granular/Kconfig
```kconfig
# Copyright (c) 2026 Intel Corporation.
# SPDX-License-Identifier: Apache-2.0

mainmenu "Word granular library tests"

source "Kconfig.zephyr"

config TEST_WORD_GRANULAR_SECTION
	string "Section name for the test's buffer in word-granular memory"
	default ".iram.data"
	help
	  The section name to place the test's word-granular memory buffer.
	  This section should be placed in word-granular memory by the
	  linker script.
```

## tests/lib/word_granular/testcase.yaml
```yaml
tests:
  libraries.word_granular:
    filter: CONFIG_ARCH_HAS_WORD_GRANULAR_INSTR_MEM
```
