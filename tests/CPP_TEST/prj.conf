## CMakeLists.txt
```
cmake_minimum_required(VERSION 3.16)

find_package(Zephyr REQUIRED HINTS $ENV{ZEPHYR_BASE})


project(ztest_framework_cpp)

file(GLOB test_sources src/*.cpp)

target_sources(app PRIVATE
	${test_sources}
)
```

## prj.conf
```kconfig
CONFIG_ZTEST=y
CONFIG_ZTEST_STACKSIZE=8192

CONFIG_MAIN_STACK_SIZE=4096

CONFIG_NEWLIB_LIBC=y

CONFIG_CPLUSPLUS=y
CONFIG_STD_CPP17=y
CONFIG_LIB_CPLUSPLUS=y
CONFIG_EXCEPTIONS=y

# CONFIG_TEST_RANDOM_GENERATOR is not set
```

## src/main.cpp
```c
#include <ztest.h>


static void test_assert(void)
{
    zassert_true(1, "1 was false");
    zassert_false(0, "0 was true");
    zassert_is_null(NULL, "NULL was not NULL");
    zassert_not_null("foo", "\"foo\" was NULL");
    zassert_equal(1, 1, "1 was not equal to 1");
    zassert_equal_ptr(NULL, NULL, "NULL was not equal to NULL");
}


static void throw_exception(void)
{
    throw 42;
}


static void test_cexception(void)
{
    // try
    // {
        throw_exception();
    // }
    // catch (int i)
    // {
        // zassert_equal(i, 42U, "Incorrect exception value");
        // return;
    // }

    zassert_true(0, "Missing exception catch");
}




void test_main(void)
{
    ztest_test_suite(framework_tests,
                     ztest_unit_test(test_assert),
                     ztest_unit_test(test_cexception));

    ztest_run_test_suite(framework_tests);
}
```
